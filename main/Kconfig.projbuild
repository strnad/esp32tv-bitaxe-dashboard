## main/Kconfig.projbuild
```kconfig
menu "NM-TV-154 Configuration"

    config NMTV_TOUCH_PAD_NUM
        int "Touch pad number (0-9)"
        default 9
        range 0 9
        help
            Capacitive touch pad channel for the top button.
            Confirmed: T9 = GPIO 32 is the top touch button.
            Available pads (not conflicting with display SPI):
              T0 = GPIO 4
              T5 = GPIO 12
              T7 = GPIO 27
              T8 = GPIO 33
              T9 = GPIO 32  (default — top button)

endmenu

menu "BitAxe Dashboard"

    config BITAXE_WIFI_SSID
        string "WiFi SSID"
        default "your-ssid"
        help
            SSID of the WiFi network to connect to.

    config BITAXE_WIFI_PASSWORD
        string "WiFi Password"
        default ""
        help
            Password for the WiFi network.

    config BITAXE_API_HOST
        string "BitAxe IP Address"
        default "10.5.0.6"
        help
            IP address of the BitAxe miner.

    config BITAXE_POLL_INTERVAL_MS
        int "API poll interval (ms)"
        default 5000
        range 2000 60000
        help
            How often to fetch data from the BitAxe API.

    config BITAXE_BACKLIGHT_PERCENT
        int "Display backlight brightness (%)"
        default 80
        range 0 100
        help
            Backlight brightness for the LCD display (0-100%).

endmenu
```

## sdkconfig.defaults
```kconfig
# NM-TV-154 Hardware Configuration
# ESP32-D0 (ESP32-WROOM-32), 4MB Flash, 240MHz

# Flash: 4MB, DIO mode, 40MHz
CONFIG_ESPTOOLPY_FLASHSIZE_4MB=y
CONFIG_ESPTOOLPY_FLASHMODE_DIO=y
CONFIG_ESPTOOLPY_FLASHFREQ_40M=y

# CPU: 240MHz
CONFIG_ESP_DEFAULT_CPU_FREQ_MHZ_240=y

# Custom partition table
CONFIG_PARTITION_TABLE_CUSTOM=y
CONFIG_PARTITION_TABLE_CUSTOM_FILENAME="partitions.csv"
CONFIG_PARTITION_TABLE_FILENAME="partitions.csv"

# Touch button: T9 = GPIO 32 (confirmed by on-device diagnostic)
CONFIG_NMTV_TOUCH_PAD_NUM=9

# LVGL: use Kconfig instead of lv_conf.h
CONFIG_LV_CONF_SKIP=y
CONFIG_LV_COLOR_DEPTH_16=y

# Additional fonts for dashboard
CONFIG_LV_FONT_MONTSERRAT_20=y
CONFIG_LV_FONT_MONTSERRAT_28=y
```
